## firmware/config/boards/shields/dactyl_alps/Kconfig.defconfig
```kconfig
if SHIELD_DACTYL_ALPS_LEFT

    config ZMK_KEYBOARD_NAME
        default "Dactyl Alps"

    config ZMK_SPLIT_BLE_ROLE_CENTRAL
        default y

    config ZMK_BATTERY_NRF_VDDH
	    default y
endif

if SHIELD_DACTYL_ALPS_RIGHT

    config ZMK_KEYBOARD_NAME
        default "Dactyl Alps R"
endif
if SHIELD_DACTYL_ALPS_LEFT || SHIELD_DACTYL_ALPS_RIGHT

    config ZMK_SPLIT
        default y

endif
```

## firmware/config/boards/shields/dactyl_alps/Kconfig.shield
```kconfig
config SHIELD_DACTYL_ALPS_LEFT
    def_bool $(shields_list_contains,dactyl_alps_left)

config SHIELD_DACTYL_ALPS_RIGHT
    def_bool $(shields_list_contains,dactyl_alps_right)
```

## firmware/config/boards/shields/dactyl_alps/build/Kconfig/Kconfig.modules
```kconfig
menu "CANopenNode (/Users/vallyashov/study/keebs/zmk/modules/lib/canopennode)"
osource "$(ZEPHYR_CANOPENNODE_KCONFIG)"
config ZEPHYR_CANOPENNODE_MODULE
	bool
	default y
endmenu
menu "hal_gigadevice (/Users/vallyashov/study/keebs/zmk/modules/hal/gigadevice)"
osource "$(ZEPHYR_HAL_GIGADEVICE_KCONFIG)"
config ZEPHYR_HAL_GIGADEVICE_MODULE
	bool
	default y
endmenu
menu "hal_nordic (/Users/vallyashov/study/keebs/zmk/modules/hal/nordic)"
osource "$(ZEPHYR_HAL_NORDIC_KCONFIG)"
config ZEPHYR_HAL_NORDIC_MODULE
	bool
	default y
endmenu
menu "hal_rpi_pico (/Users/vallyashov/study/keebs/zmk/modules/hal/rpi_pico)"
osource "$(ZEPHYR_HAL_RPI_PICO_KCONFIG)"
config ZEPHYR_HAL_RPI_PICO_MODULE
	bool
	default y
endmenu
menu "lz4 (/Users/vallyashov/study/keebs/zmk/modules/lib/lz4)"
osource "$(ZEPHYR_LZ4_KCONFIG)"
config ZEPHYR_LZ4_MODULE
	bool
	default y
endmenu
menu "mbedtls (/Users/vallyashov/study/keebs/zmk/modules/crypto/mbedtls)"
osource "$(ZEPHYR_MBEDTLS_KCONFIG)"
config ZEPHYR_MBEDTLS_MODULE
	bool
	default y
endmenu
menu "nanopb (/Users/vallyashov/study/keebs/zmk/modules/lib/nanopb)"
osource "$(ZEPHYR_NANOPB_KCONFIG)"
config ZEPHYR_NANOPB_MODULE
	bool
	default y
endmenu
menu "sof (/Users/vallyashov/study/keebs/zmk/modules/audio/sof)"
osource "/Users/vallyashov/study/keebs/zmk/modules/audio/sof/zephyr/Kconfig"
config ZEPHYR_SOF_MODULE
	bool
	default y
endmenu
menu "tflite-micro (/Users/vallyashov/study/keebs/zmk/modules/lib/tflite-micro)"
osource "$(ZEPHYR_TFLITE_MICRO_KCONFIG)"
config ZEPHYR_TFLITE_MICRO_MODULE
	bool
	default y
endmenu
menu "TraceRecorder (/Users/vallyashov/study/keebs/zmk/modules/debug/TraceRecorder)"
osource "/Users/vallyashov/study/keebs/zmk/modules/debug/TraceRecorder/kernelports/Zephyr/Kconfig"
config ZEPHYR_TRACERECORDER_MODULE
	bool
	default y
endmenu
menu "zscilib (/Users/vallyashov/study/keebs/zmk/modules/lib/zscilib)"
osource "/Users/vallyashov/study/keebs/zmk/modules/lib/zscilib/Kconfig.zscilib"
config ZEPHYR_ZSCILIB_MODULE
	bool
	default y
endmenu
menu "drivers (/Users/vallyashov/study/keebs/zmk/app/drivers)"
osource "/Users/vallyashov/study/keebs/zmk/app/drivers/Kconfig"
config ZEPHYR_DRIVERS_MODULE
	bool
	default y
endmenu
```

## firmware/config/boards/shields/dactyl_alps/build/Kconfig/Kconfig.shield.defconfig
```kconfig
osource "/Users/vallyashov/study/keebs/zmk/app/boards/shields/*/Kconfig.defconfig"
osource "/Users/vallyashov/study/keebs/dactyl-alps-zmk/firmware/config/boards/shields/*/Kconfig.defconfig"
```

## firmware/config/build/Kconfig/Kconfig.modules
```kconfig
menu "hal_nordic (/Users/vallyashov/study/keebs/zmk/modules/hal/nordic)"
osource "$(ZEPHYR_HAL_NORDIC_KCONFIG)"
config ZEPHYR_HAL_NORDIC_MODULE
	bool
	default y
endmenu
menu "sof (/Users/vallyashov/study/keebs/zmk/modules/audio/sof)"
osource "/Users/vallyashov/study/keebs/zmk/modules/audio/sof/zephyr/Kconfig"
config ZEPHYR_SOF_MODULE
	bool
	default y
endmenu
menu "drivers (/Users/vallyashov/study/keebs/zmk/app/drivers)"
osource "/Users/vallyashov/study/keebs/zmk/app/drivers/Kconfig"
config ZEPHYR_DRIVERS_MODULE
	bool
	default y
endmenu
```

## firmware/config/build/Kconfig/Kconfig.shield
```kconfig
osource "/Users/vallyashov/study/keebs/zmk/app/boards/shields/*/Kconfig.shield"
osource "/Users/vallyashov/study/keebs/dactyl-alps-zmk/firmware/config/boards/shields/*/Kconfig.shield"
osource "/Users/vallyashov/study/keebs/zmk/zephyr/boards/shields/*/Kconfig.shield"
osource "/Users/vallyashov/study/keebs/zmk/zephyr/boards/shields/*/Kconfig.shield"
```

## firmware/config/build/Kconfig/Kconfig.soc.arch
```kconfig
osource "/Users/vallyashov/study/keebs/zmk/zephyr/soc/$(ARCH)/Kconfig"
osource "/Users/vallyashov/study/keebs/zmk/zephyr/soc/$(ARCH)/*/Kconfig"
```

## firmware/config/build/Kconfig/Kconfig.soc.defconfig
```kconfig
osource "/Users/vallyashov/study/keebs/zmk/zephyr/soc/$(ARCH)/*/Kconfig.defconfig"
```
